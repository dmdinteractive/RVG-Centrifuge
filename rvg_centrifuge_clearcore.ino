// =====================================================================
// CENTRIFUGE CONTROL - CLEARCORE VERSION
// Teknic ClearCore + ClearPath SDSK + Cabinet Lock Relay + Start Button
//
// Ported from the Arduino R4 version (v3.0). Same timing and S-curve
// ramp profile. Changes from the R4 version:
//   - A start button (I/O-1) is now required: lid closed + press = start
//   - Status LEDs removed
//   - Step pulses are generated by ClearCore hardware (no bit-banging)
//   - Motor faults (via HLFB) stop the cycle and hold the lock
//
// ---------------------------------------------------------------------
// POWER (per ClearCore Hardware & Wiring Manual Rev 1.14)
//   - ClearCore: 24VDC (20-28V) on the POWER terminal. Teknic recommends
//     a 6.5A+ supply (e.g. Mean Well LRS-150-24).
//   - ClearPath: SEPARATE motor power supply (e.g. Teknic IPC-5).
//     Do NOT power the ClearPath from the ClearCore's 24V supply.
//   - Mount ClearCore to a grounded (protective earth) chassis, or wire
//     the chassis terminal on the power connector to the frame.
//
// WIRING (ClearCore connectors)
//   Each I/O connector has 3 terminals: + (24V), G (ground), S (signal).
//   Confirm terminal order against the label printed on the ClearCore.
//   M-0  : ClearPath SDSK via Teknic 8-pin Mini-Fit controller cable
//          (CPM-CABLE-CTRL-MU120 = 10 ft, CPM-CABLE-CTRL-MM660 = 55 ft)
//   I/O-0: HES 610 cabinet lock, driven directly: lock terminal 1 to +,
//          lock terminal 4 to S, jumper 2-3 (24 V wiring), ~130 mA.
//          ClearCore outputs switch the low side ("negative true").
//          HES requires its recovery diode across the coil on DC
//          (banded end to terminal 1), even with ClearCore's clamping.
//          Lock rosette set to FAIL-UNLOCKED:
//          I/O-0 energized = LOCKED, de-energized = UNLOCKED.
//          A power loss or reset leaves the lid unlocked.
//   I/O-1: Start button (normally open), wired between S and G
//   I/O-2: Magnetic lid switch (normally open reed), wired between S and G
//          Inputs are "negative true": ON when S is pulled to G.
//          (magnet present / lid closed = switch closed = input ON)
//   Each I/O point has its own LED on the ClearCore - use these to
//   confirm the button, lid switch, and relay output while testing.
//
// ---------------------------------------------------------------------
// CLEARPATH SETTINGS REQUIRED IN MSP (Teknic's configuration software)
//   1. Mode: Step and Direction
//   2. Input Resolution: 400 pulses per revolution (matches STEPS_PER_REV)
//   3. Advanced > High Level Feedback: "ASG-Position w/Measured Torque"
//      with PWM Carrier Frequency = 482 Hz
//   The ClearCore library cancels motion if HLFB reads as "off" while
//   the motor is enabled, so step 3 is required, not optional.
//
// BOARD SETUP (Arduino IDE 2.x - per Teknic "Getting Started")
//   1. Run Teknic's ClearCore Arduino 2 Wrapper Installer, OR manually:
//      File > Preferences > Additional Boards Manager URLs, add
//        https://www.teknic.com/files/downloads/package_clearcore_index.json
//      then Tools > Board > Boards Manager, search "ClearCore", Install.
//      (Manual route on Windows also needs Teknic's USB port driver:
//       ClearCore_Port_Driver_Install.zip)
//   2. Select Tools > Board > ClearCore > Teknic ClearCore
//   3. Power the ClearCore, connect USB, select the "Teknic ClearCore" port.
//   4. First test: upload File > Examples > (ClearCore section) >
//      WriteDigitalOutput. The I/O LEDs should blink. Only use examples
//      in the sections starting with "ClearCore".
//   5. Upload this sketch. It runs automatically on every power-up.
//
// RECOVERY: Press RESET once to restart the program. Double-press RESET
//   to enter bootloader mode (use if the ClearCore crashes or won't upload).
// =====================================================================

#include "ClearCore.h"

// ---------------- Connector assignments ----------------
#define motor        ConnectorM0    // ClearPath SDSK
#define lockRelay    ConnectorIO0   // Cabinet lock relay coil
#define startButton  ConnectorIO1   // Start push button
#define lidSwitch    ConnectorIO2   // Magnetic lid switch

// ---------------- Motor parameters (same as R4 version) ----------------
const int   STEPS_PER_REV = 400;    // Must match ClearPath Input Resolution in MSP
const int   MAX_RPM       = 3000;   // Top speed
const float MIN_RPM       = 5.0;    // Below this the motor is simply stopped (same as R4)

// ---------------- Timing (same as R4 version) ----------------
unsigned long rampUpTime    = 5000;   // 5 seconds to ramp up
unsigned long holdTime      = 5000;   // 5 seconds at full speed
unsigned long rampDownTime  = 10000;  // 10 seconds to ramp down
unsigned long postSpinDelay = 3000;   // Keep lid locked this long after stop
unsigned long preStartDelay = 0;      // Minimum wait after START before spinning
const unsigned long ENABLE_TIMEOUT = 3000; // Max wait for the ClearPath to report ready (HLFB)

// ---------------- ClearCore-specific settings ----------------
const unsigned long VELOCITY_UPDATE_MS = 10;     // How often the S-curve speed is re-sent
const float         ACCEL_MARGIN       = 1.25;   // Accel limit headroom above the S-curve's steepest point
const uint16_t      INPUT_FILTER_MS    = 20;     // Debounce time for button and lid switch
const unsigned long FAULT_HOLD_TIME    = 30000;  // Keep lid locked this long after a motor fault
                                                 // (a faulted ClearPath lets the rotor coast)

// ---------------- State machine ----------------
enum SystemState {
  WAITING_FOR_LID_CLOSE,
  WAITING_FOR_START_BUTTON,   // NEW: lid is closed, waiting for a button press
  PRE_START_DELAY,
  RAMPING_UP,
  HOLDING_SPEED,
  RAMPING_DOWN,
  POST_SPIN_DELAY,
  WAITING_FOR_LID_OPEN,
  FAULT_LOCKOUT               // NEW: motor faulted, lid held locked for FAULT_HOLD_TIME
};

SystemState   currentState   = WAITING_FOR_LID_CLOSE;
unsigned long stateStartTime = 0;
unsigned long lastVelocityUpdate = 0;
bool spinClockwise      = true;
bool lastLidState       = false;
bool lastButtonState    = false;
bool lidWasOpened       = true;   // Start assuming lid was opened to allow first cycle
bool motorStopCommanded = false;  // Used during ramp-down so the stop is only sent once
bool moveRejectReported = false;  // Avoids flooding serial if moves are rejected

// Forward declarations
bool isLidClosed();
bool isStartPressed();
void lockLid();
void unlockLid();
void enableMotor();
void stopMotor();
void commandRpm(float rpm);
bool motorHasAlert();
void enterFault(const char *reason);
void printStateName(SystemState state);
void changeState(SystemState newState);
void goToLidOpenWait();

// =====================================================================
void setup() {
  // ---- Serial (USB) ----
  Serial.begin(9600);
  unsigned long serialWaitStart = millis();
  while (!Serial && millis() - serialWaitStart < 3000) {
    // Wait up to 3 s for a USB serial connection; runs fine without one
  }

  // ---- I/O setup ----
  lockRelay.Mode(Connector::OUTPUT_DIGITAL);
  startButton.Mode(Connector::INPUT_DIGITAL);
  lidSwitch.Mode(Connector::INPUT_DIGITAL);

  // Hardware debounce: input must be stable this long before it changes state
  startButton.FilterLength(INPUT_FILTER_MS, DigitalIn::FILTER_UNIT_MS);
  lidSwitch.FilterLength(INPUT_FILTER_MS, DigitalIn::FILTER_UNIT_MS);

  unlockLid();   // Start unlocked; the lid switch will engage the lock when closed

  // ---- Motor setup ----
  MotorMgr.MotorInputClocking(MotorManager::CLOCK_RATE_NORMAL);
  MotorMgr.MotorModeSet(MotorManager::MOTOR_ALL, Connector::CPM_MODE_STEP_AND_DIR);
  motor.HlfbMode(MotorDriver::HLFB_MODE_HAS_BIPOLAR_PWM);
  motor.HlfbCarrier(MotorDriver::HLFB_CARRIER_482_HZ);

  // Acceleration limit: set just above the steepest point of the S-curve.
  // The S-curve (smoothstep) peaks at 1.5x the average acceleration.
  float maxStepsPerSec = MAX_RPM * STEPS_PER_REV / 60.0;
  float peakAccelUp    = 1.5 * maxStepsPerSec / (rampUpTime / 1000.0);
  float peakAccelDown  = 1.5 * maxStepsPerSec / (rampDownTime / 1000.0);
  float peakAccel      = (peakAccelUp > peakAccelDown) ? peakAccelUp : peakAccelDown;
  uint32_t accelLimit  = (uint32_t)(peakAccel * ACCEL_MARGIN);
  motor.AccelMax(accelLimit);
  motor.VelMax((uint32_t)(maxStepsPerSec * 1.1));  // Only applies to position moves; set for safety

  motor.EnableRequest(false);  // Motor disabled until a cycle starts

  Serial.println("=================================");
  Serial.println("Centrifuge Control System v4.1 (ClearCore)");
  Serial.println("Close lid, then press START");
  Serial.println("=================================");
  Serial.print("Top speed: ");
  Serial.print(MAX_RPM);
  Serial.print(" RPM = ");
  Serial.print(maxStepsPerSec, 0);
  Serial.println(" steps/sec");
  Serial.print("Acceleration limit: ");
  Serial.print(accelLimit);
  Serial.println(" steps/sec^2");
  Serial.println("\nLock Operation (HES 610, fail-unlocked):");
  Serial.println("- Lock UNLOCKED (de-energized) while lid is open");
  Serial.println("- Lock ENGAGES (energized) when lid closes");
  Serial.println("- Lock STAYS ENGAGED during cycle");
  Serial.println("- Lock UNLOCKS after cycle completes");
  Serial.println("\nOperation:");
  Serial.println("1. Open lid, insert samples");
  Serial.println("2. Close lid (lock engages)");
  Serial.println("3. Press START -> spin begins once the motor is ready");
  Serial.println("4. Cycle ends -> lock releases");
  Serial.println("5. Open lid to remove samples");
  Serial.println("=================================");

  // ---- Input test printout ----
  Serial.println("--- INPUT TEST ---");
  Serial.print("Lid switch (I/O-2): ");
  Serial.println(isLidClosed() ? "CLOSED (magnet present)" : "OPEN (no magnet)");
  Serial.print("Start button (I/O-1): ");
  Serial.println(isStartPressed() ? "PRESSED" : "released");
  Serial.println("The I/O LED on the ClearCore lights when an input is ON (closed)");
  Serial.println("----------------------\n");

  if (isLidClosed()) {
    lockLid();
    lidWasOpened = false;
    changeState(WAITING_FOR_START_BUTTON);
    Serial.println("Lid is closed - lock engaged; press START");
  } else {
    unlockLid();
    Serial.println("System ready - Lid is open and unlocked; close lid to engage lock");
  }

  lastLidState    = isLidClosed();
  lastButtonState = isStartPressed();
}

// =====================================================================
void loop() {
  bool lidClosed     = isLidClosed();
  bool buttonDown    = isStartPressed();
  bool buttonPressed = buttonDown && !lastButtonState;  // true only on the moment of press
  lastButtonState    = buttonDown;

  bool motorRunning = (currentState == RAMPING_UP ||
                       currentState == HOLDING_SPEED ||
                       currentState == RAMPING_DOWN);

  // ---- Debug output every 2 seconds (only when motor not running) ----
  static unsigned long lastDebugTime = 0;
  if (!motorRunning && millis() - lastDebugTime >= 2000) {
    Serial.println("=== STATUS DEBUG ===");
    Serial.print("Lid is: ");
    Serial.print(lidClosed ? "CLOSED" : "OPEN");
    Serial.print(" | Button: ");
    Serial.println(buttonDown ? "PRESSED" : "released");
    Serial.print("Current State: ");
    printStateName(currentState);
    Serial.print(" | Lid was opened: ");
    Serial.println(lidWasOpened ? "YES" : "NO");
    Serial.println("==================");
    lastDebugTime = millis();
  }

  // ---- Simple lid/lock handling ----
  if (lidClosed != lastLidState) {
    Serial.println("!!! LID STATUS CHANGE DETECTED !!!");
    Serial.print("Lid is now: ");
    Serial.println(lidClosed ? "CLOSED" : "OPEN");

    if (!lidClosed) {
      lidWasOpened = true;

      bool cycleStillSecured = (currentState == PRE_START_DELAY ||
                                currentState == RAMPING_UP ||
                                currentState == HOLDING_SPEED ||
                                currentState == RAMPING_DOWN ||
                                currentState == POST_SPIN_DELAY ||
                                currentState == FAULT_LOCKOUT);
      if (cycleStillSecured) {
        lockLid();
        Serial.println("Lid opened during secured cycle - locks remain ENGAGED");
      } else {
        unlockLid();
        Serial.println("Lid opened - locks UNLOCKED");
        changeState(WAITING_FOR_LID_CLOSE);
      }
    } else {
      // Lid just closed
      if (currentState == WAITING_FOR_LID_CLOSE) {
        lockLid();
        Serial.println("=================================");
        Serial.println("LID CLOSED - Press START to begin");
        Serial.println("=================================");
        changeState(WAITING_FOR_START_BUTTON);
      }
    }
    lastLidState = lidClosed;
  }

  // ---- State machine ----
  switch (currentState) {

    case WAITING_FOR_LID_CLOSE:
      if (buttonPressed) {
        Serial.println("START ignored - close the lid first");
      }
      break;

    case WAITING_FOR_START_BUTTON:
      if (buttonPressed && lidClosed) {
        Serial.println("=================================");
        Serial.println("START PRESSED - STARTING CYCLE");
        Serial.println("Starting motor...");
        Serial.println("Locks remain ENGAGED during cycle");
        Serial.println("=================================");
        lidWasOpened = false;
        lockLid();       // Confirm the lock output before enabling the motor
        enableMotor();   // Enable now so the ClearPath is ready when the ramp starts
        changeState(PRE_START_DELAY);
      }
      break;

    case PRE_START_DELAY: {
      unsigned long elapsed = millis() - stateStartTime;

      // Wait at least preStartDelay, then until the ClearPath reports ready
      if (elapsed < preStartDelay) break;

      if (motor.HlfbState() != MotorDriver::HLFB_ASSERTED) {
        if (elapsed >= preStartDelay + ENABLE_TIMEOUT) {
          enterFault("Motor did not finish enabling (HLFB not asserted)");
        }
        break;   // Not ready yet - check again next loop
      }

      motor.ClearAlerts();   // Clear anything left over from enabling
      Serial.print("Motor ready after ");
      Serial.print(elapsed);
      Serial.println(" ms - Starting motor!");
      Serial.print("Direction: ");
      Serial.println(spinClockwise ? "Clockwise" : "Counter-Clockwise");
      motorStopCommanded = false;
      moveRejectReported = false;
      lastVelocityUpdate = 0;
      changeState(RAMPING_UP);
      break;
    }

    case RAMPING_UP: {
      if (motorHasAlert()) { enterFault("Motor alert during ramp up"); break; }

      if (millis() - lastVelocityUpdate >= VELOCITY_UPDATE_MS) {
        lastVelocityUpdate = millis();
        float progress = (float)(millis() - stateStartTime) / rampUpTime;
        if (progress > 1.0) progress = 1.0;
        progress = progress * progress * (3.0 - 2.0 * progress);  // Same S-curve as R4
        float currentRPM = MAX_RPM * progress;
        if (currentRPM > MIN_RPM) {
          commandRpm(currentRPM);
        }
      }

      if (millis() - stateStartTime >= rampUpTime) {
        commandRpm(MAX_RPM);   // Make sure we land exactly on top speed
        Serial.println("At full speed");
        changeState(HOLDING_SPEED);
      }
      break;
    }

    case HOLDING_SPEED:
      // ClearCore keeps stepping at the last commanded speed on its own
      if (motorHasAlert()) { enterFault("Motor alert at full speed"); break; }

      if (millis() - stateStartTime >= holdTime) {
        Serial.println("Starting ramp down");
        lastVelocityUpdate = 0;
        changeState(RAMPING_DOWN);
      }
      break;

    case RAMPING_DOWN: {
      if (motorHasAlert()) { enterFault("Motor alert during ramp down"); break; }

      if (millis() - lastVelocityUpdate >= VELOCITY_UPDATE_MS) {
        lastVelocityUpdate = millis();
        float progress = (float)(millis() - stateStartTime) / rampDownTime;
        if (progress > 1.0) progress = 1.0;
        progress = progress * progress * (3.0 - 2.0 * progress);  // Same S-curve as R4
        float currentRPM = MAX_RPM * (1.0 - progress);
        if (currentRPM > MIN_RPM) {
          commandRpm(currentRPM);
        } else if (!motorStopCommanded) {
          motor.MoveStopAbrupt();   // Same as R4: stop stepping below 5 RPM
          motorStopCommanded = true;
        }
      }

      if (millis() - stateStartTime >= rampDownTime) {
        Serial.println("Motor stopped - Post-spin safety delay");
        stopMotor();
        spinClockwise = !spinClockwise;
        changeState(POST_SPIN_DELAY);
      }
      break;
    }

    case POST_SPIN_DELAY:
      if (millis() - stateStartTime >= postSpinDelay) {
        Serial.println("Cycle complete - UNLOCKING lid");
        unlockLid();
        Serial.println("Lid UNLOCKED - Open lid to remove samples");
        Serial.println("Must open and close lid for next cycle");
        goToLidOpenWait();
      }
      break;

    case WAITING_FOR_LID_OPEN:
      if (buttonPressed) {
        Serial.println("START ignored - open and close the lid first");
      }
      break;

    case FAULT_LOCKOUT:
      // Lid stays locked while a faulted rotor may still be coasting
      if (millis() - stateStartTime >= FAULT_HOLD_TIME) {
        Serial.println("Fault hold time elapsed - UNLOCKING lid");
        Serial.println("Motor fault will be cleared on the next START");
        unlockLid();
        goToLidOpenWait();
      }
      break;
  }
}

// =====================================================================
// Helper functions
// =====================================================================

// ClearCore inputs read ON (true) when the switch closes S to G.
// Reed switch: magnet present (lid closed) = switch closed = true.
bool isLidClosed() {
  return lidSwitch.State();
}

bool isStartPressed() {
  return startButton.State();
}

// Direct-drive lock output polarity:
// IO-0 de-energized = lid unlocked; IO-0 energized = lid locked.
void lockLid() {
  lockRelay.State(true);
  Serial.println("Lid LOCKED (IO-0 ENERGIZED)");
}

void unlockLid() {
  lockRelay.State(false);
  Serial.println("Lid UNLOCKED (IO-0 DE-ENERGIZED)");
}

void enableMotor() {
  Serial.println(">>> ENABLING MOTOR <<<");
  // If a previous fault is latched, cycling enable clears it on the ClearPath
  if (motor.StatusReg().bit.MotorInFault || motor.StatusReg().bit.AlertsPresent) {
    Serial.println("Previous alert present - cycling enable");
    motor.EnableRequest(false);
    delay(20);
  }
  motor.EnableRequest(true);
}

void stopMotor() {
  Serial.println(">>> STOPPING MOTOR <<<");
  motor.MoveStopAbrupt();
  motor.EnableRequest(false);
  Serial.println("Motor disabled");
}

// Converts RPM to steps/sec and sends it. Direction comes from the sign.
void commandRpm(float rpm) {
  int32_t stepsPerSec = (int32_t)(rpm * STEPS_PER_REV / 60.0 + 0.5);
  if (stepsPerSec < 1) return;
  if (!spinClockwise) stepsPerSec = -stepsPerSec;

  if (!motor.MoveVelocity(stepsPerSec) && !moveRejectReported) {
    Serial.println("WARNING: velocity command rejected by ClearCore");
    Serial.print("Alert register: 0x");
    Serial.println(motor.AlertReg().reg, HEX);
    moveRejectReported = true;
  }
}

bool motorHasAlert() {
  return motor.StatusReg().bit.AlertsPresent;
}

void enterFault(const char *reason) {
  Serial.println("#################################");
  Serial.print("FAULT: ");
  Serial.println(reason);
  Serial.print("Alert register: 0x");
  Serial.println(motor.AlertReg().reg, HEX);
  Serial.print("Lid stays LOCKED for ");
  Serial.print(FAULT_HOLD_TIME / 1000);
  Serial.println(" seconds");
  Serial.println("#################################");
  stopMotor();
  // Lock is already engaged during a cycle; make sure of it.
  lockLid();
  changeState(FAULT_LOCKOUT);
}

// After an unlock: wait for the lid to open, unless it is already open
// (e.g. it was opened during a fault lockout), in which case wait for close.
void goToLidOpenWait() {
  if (isLidClosed()) {
    changeState(WAITING_FOR_LID_OPEN);
  } else {
    Serial.println("Lid already open - close lid to start a new cycle");
    changeState(WAITING_FOR_LID_CLOSE);
  }
}

void changeState(SystemState newState) {
  currentState   = newState;
  stateStartTime = millis();
}

void printStateName(SystemState state) {
  switch (state) {
    case WAITING_FOR_LID_CLOSE:    Serial.print("WAITING_FOR_LID_CLOSE");    break;
    case WAITING_FOR_START_BUTTON: Serial.print("WAITING_FOR_START_BUTTON"); break;
    case PRE_START_DELAY:          Serial.print("PRE_START_DELAY");          break;
    case RAMPING_UP:               Serial.print("RAMPING_UP");               break;
    case HOLDING_SPEED:            Serial.print("HOLDING_SPEED");            break;
    case RAMPING_DOWN:             Serial.print("RAMPING_DOWN");             break;
    case POST_SPIN_DELAY:          Serial.print("POST_SPIN_DELAY");          break;
    case WAITING_FOR_LID_OPEN:     Serial.print("WAITING_FOR_LID_OPEN");     break;
    case FAULT_LOCKOUT:            Serial.print("FAULT_LOCKOUT");            break;
  }
}
